## uboot/configs/clockworkpi-cpi3_defconfig
```kconfig
CONFIG_ARM=y
CONFIG_ARCH_SUNXI=y
CONFIG_SPL=y
CONFIG_MACH_SUN8I_A33=y
CONFIG_DRAM_CLK=600
CONFIG_DRAM_ZQ=15291
CONFIG_DRAM_ODT_EN=y
CONFIG_MMC0_CD_PIN="PB3"
CONFIG_MMC_SUNXI_SLOT_EXTRA=2
CONFIG_USB0_ID_DET="PL4"
CONFIG_VIDEO_LCD_MODE="x:320,y:240,depth:18,pclk_khz:5800,le:60,ri:6,up:6,lo:2,hs:2,vs:2,sync:3,vmode:0"
CONFIG_VIDEO_LCD_DCLK_PHASE=0
# CONFIG_VIDEO_LCD_BL_PWM_ACTIVE_LOW is not set
# CONFIG_SYS_MALLOC_CLEAR_ON_INIT is not set
CONFIG_BOOTDELAY=0
CONFIG_DEFAULT_DEVICE_TREE="sun8i-r16-clockworkpi-cpi3"
```
